#include <ttydr/defs.h>

SECTIONS
{

  . = PAYLOAD_RAM;
  .text : {
    SORT(*)(.text*);
    SORT(*)(.data*);
    SORT(*)(.rodata*);
    SORT(*)(.bss*);
  }

  . = 0x82000000;
  .patch : {
    SORT(*)(.patch);
  }
  /DISCARD/ : { *(.*); }

  DVDResume = 0x802a68d0;
  ReadDisc = 0x8029c0d0;
}
